## Firmware/firmware_esp/Audio_Hardware_Test/sdkconfig.defaults
```kconfig
# Target & CPU
CONFIG_IDF_TARGET="esp32s3"
CONFIG_ESP_DEFAULT_CPU_FREQ_MHZ_240=y
CONFIG_ESP_DEFAULT_CPU_FREQ_MHZ=240

# 16MB Flash
CONFIG_ESPTOOLPY_FLASHSIZE_16MB=y
CONFIG_ESPTOOLPY_FLASHSIZE="16MB"
CONFIG_ESPTOOLPY_FLASHMODE_DIO=y
CONFIG_ESPTOOLPY_FLASHFREQ_80M=y

# 8MB Octal PSRAM (N16R8)
CONFIG_SPIRAM=y
CONFIG_SPIRAM_MODE_OCT=y
CONFIG_SPIRAM_TYPE_AUTO=y
CONFIG_SPIRAM_ALLOW_STACK_EXTERNAL_MEMORY=y
CONFIG_SPIRAM_SPEED_80M=y
CONFIG_SPIRAM_SPEED=80
CONFIG_SPIRAM_BOOT_INIT=y
CONFIG_SPIRAM_IGNORE_NOTFOUND=y
CONFIG_SPIRAM_USE_MALLOC=y
CONFIG_SPIRAM_MEMTEST=y
CONFIG_SPIRAM_MALLOC_ALWAYSINTERNAL=16384
CONFIG_SPIRAM_MALLOC_RESERVE_INTERNAL=32768

# Custom Partition Table
CONFIG_PARTITION_TABLE_CUSTOM=y
CONFIG_PARTITION_TABLE_CUSTOM_FILENAME="partitions.csv"
CONFIG_PARTITION_TABLE_FILENAME="partitions.csv"

# USB-Serial/JTAG Console (Matches COM8 on ESP32-S3)
CONFIG_ESP_CONSOLE_USB_SERIAL_JTAG=y
CONFIG_ESP_CONSOLE_SECONDARY_NONE=y

# FreeRTOS 1000Hz Tick
CONFIG_FREERTOS_HZ=1000

# Main Task Stack Size
CONFIG_ESP_MAIN_TASK_STACK_SIZE=10240
```

## archive/2026-10-28-cleanup/files/Firmware/firmware_esp/ActionBox/src/Kconfig.projbuild
```kconfig
menu "ActionBox radio"
    config ACTIONBOX_ESPNOW_CHANNEL
        int "2.4 GHz channel of the SubBox access point"
        range 1 13
        default 11
        help
            Set this to the fixed Wi-Fi AP channel used by SubBox.
            ESP-NOW peers follow this channel. Automatic channel discovery
            is not implemented.
endmenu
```
